## config/west.yml
```yaml
manifest:
  remotes:
    - name: zmkfirmware
      url-base: https://github.com/zmkfirmware
    - name: rschenk
      url-base: https://github.com/rschenk
  projects:
    - name: zmk
      remote: zmkfirmware
      import: app/west.yml
      revision: main
    - name: zmk-keyboard-re-gret
      remote: rschenk
      revision: main
  self:
    path: config
```
